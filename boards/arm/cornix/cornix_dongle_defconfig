## boards/arm/cornix/cornix_dongle_defconfig
```kconfig
# e73 config
CONFIG_SOC_SERIES_NRF52X=y
CONFIG_SOC_NRF52840_QIAA=y
CONFIG_BOARD_CORNIX_DONGLE=y


CONFIG_ADC_NRFX_SAADC=y

# Enable MPU
CONFIG_ARM_MPU=y

CONFIG_PINCTRL=y

# enable GPIO
CONFIG_GPIO=y

CONFIG_USE_DT_CODE_PARTITION=y
CONFIG_BUILD_OUTPUT_UF2=y

CONFIG_MPU_ALLOW_FLASH_WRITE=y
CONFIG_NVS=y
CONFIG_SETTINGS_NVS=y
CONFIG_FLASH=y
CONFIG_FLASH_PAGE_LAYOUT=y
CONFIG_FLASH_MAP=y
CONFIG_CLOCK_CONTROL_NRF=y
CONFIG_CLOCK_CONTROL_NRF_K32SRC_RC=y

# e73 config end

CONFIG_ZMK_USB=y
CONFIG_ZMK_SPLIT=y
CONFIG_ZMK_SPLIT_ROLE_CENTRAL=y

CONFIG_ZMK_BATTERY_REPORT_INTERVAL=60

CONFIG_PINCTRL=y
# enable display drivers

CONFIG_BT_CTLR_TX_PWR_PLUS_8=y

#BLE-passkey
CONFIG_ZMK_BLE_PASSKEY_ENTRY=n

#BLE-clean
CONFIG_ZMK_BLE_CLEAR_BONDS_ON_START=n

CONFIG_ZMK_HID_REPORT_TYPE_NKRO=n

CONFIG_ZMK_POINTING=y

# 3 profiles (n+2)
CONFIG_BT_MAX_CONN=7
CONFIG_BT_MAX_PAIRED=7

CONFIG_ZMK_SPLIT_BLE_CENTRAL_BATTERY_LEVEL_PROXY=y
CONFIG_ZMK_SPLIT_BLE_CENTRAL_BATTERY_LEVEL_FETCHING=y

# dongle mode
CONFIG_ZMK_SPLIT_BLE_CENTRAL_PERIPHERALS=2

CONFIG_BT_BAS=y

CONFIG_ZMK_BACKLIGHT=n

# zmk studio相关配置
CONFIG_ZMK_STUDIO=y
CONFIG_ZMK_STUDIO_LOCKING=n
CONFIG_ZMK_STUDIO_LOCK_ON_DISCONNECT=n
```

## boards/jzf/cornix/Kconfig
```kconfig
config BOARD_ENABLE_DCDC
    bool "Enable DCDC mode"
    select SOC_DCDC_NRF52X
    default y
    depends on ( BOARD_CORNIX_LEFT || BOARD_CORNIX_RIGHT || BOARD_CORNIX_PH_LEFT )

config BOARD_CORNIX_CHARGER
    bool "Enable battery charger"
    default y
    depends on ( BOARD_CORNIX_LEFT || BOARD_CORNIX_RIGHT || BOARD_CORNIX_PH_LEFT )
```

## boards/jzf/cornix/Kconfig.board
```kconfig
# cornix board configuration

# Copyright (c) 2020 The ZMK Contributors
# SPDX-License-Identifier: MIT

config BOARD_CORNIX
    bool "cornix"
    depends on SOC_NRF52840_QIAA

config BOARD_CORNIX_DONGLE
    bool "cornix dongle"
    depends on SOC_NRF52840_QIAA

config BOARD_CORNIX_PH_LEFT
    bool "cornix ph left"
    depends on SOC_NRF52840_QIAA
    
config BOARD_CORNIX_LEFT
    bool "cornix left"
    depends on SOC_NRF52840_QIAA

config BOARD_CORNIX_RIGHT
    bool "cornix right"
    depends on SOC_NRF52840_QIAA

#vim: set ft=kconfig:
```

## boards/shields/cornix_prospector/Kconfig.shield
```kconfig
# No whitespace after the comma or in the keyboard name!
config SHIELD_CORNIX_PROSPECTOR
    def_bool $(shields_list_contains,cornix_prospector)
```

## boards/shields/cornix_yads/Kconfig.sheild
```kconfig
# No whitespace after the comma or in the keyboard name!
config SHIELD_CORNIX_YADS_DONGLE
    def_bool $(shields_list_contains,cornix_yads_dongle)
```

## boards/shields/cornix_yads/Kconfig.shield
```kconfig
# No whitespace after the comma or in the keyboard name!
config SHIELD_CORNIX_YADS
    def_bool $(shields_list_contains,cornix_yads)
```

## config/west.yml
```yaml
manifest:
  remotes:
    - name: zmkfirmware
      url-base: https://github.com/zmkfirmware
    - name: hitsmaxft
      url-base: https://github.com/hitsmaxft
    - name: urob
      url-base: https://github.com/urob
    - name: janpfischer
      url-base: https://github.com/janpfischer
    - name: carrefinho
      url-base: https://github.com/carrefinho
    - name: bwshockley
      url-base: https://github.com/bwshockley
  projects:
    - name: zmk
      remote: zmkfirmware
      revision: main
      clone-depth: 1
      import:
        file: app/west.yml
    - name: zmk-helpers
      remote: urob
      revision: main
      clone-depth: 1
    - name: zmk-rgbled-widget
      remote: hitsmaxft
      revision: main
      clone-depth: 1
    - name: zmk-dongle-display
      remote: hitsmaxft
      revision: main
      clone-depth: 1
    - name: zmk-dongle-screen
      remote: bwshockley
      revision: main
    - name: prospector-zmk-module
      remote: carrefinho
      revision: main
  self:
    path: config
```
